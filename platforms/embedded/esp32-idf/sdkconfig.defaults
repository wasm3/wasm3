## platforms/embedded/esp32-idf/sdkconfig.defaults
```kconfig
# Increased stack size
CONFIG_ESP_MAIN_TASK_STACK_SIZE=32768

# Disable task watchdog
CONFIG_ESP_TASK_WDT=n

# Increase CPU frequency
CONFIG_ESP32_DEFAULT_CPU_FREQ_240=y
```

## platforms/esp32-idf-wasi/sdkconfig.defaults
```kconfig
# Increased stack size
CONFIG_ESP_MAIN_TASK_STACK_SIZE=65536

# Disable task watchdog
CONFIG_ESP_TASK_WDT=n

# Increase CPU frequency
CONFIG_ESP32_DEFAULT_CPU_FREQ_240=y

# PSRAM support
CONFIG_SPIRAM_SUPPORT=y
CONFIG_SPIRAM_IGNORE_NOTFOUND=y
CONFIG_SPIRAM_USE_MALLOC=y
```

## platforms/esp32-idf/sdkconfig.defaults
```kconfig
# Increased stack size
CONFIG_ESP_MAIN_TASK_STACK_SIZE=32768

# Disable task watchdog
CONFIG_ESP_TASK_WDT=n

# Increse CPU frequency
CONFIG_ESP32_DEFAULT_CPU_FREQ_240=y
```
